## config/west.yml
```yaml
manifest:
  remotes:
    - name: zmkfirmware
      url-base: https://github.com/zmkfirmware
    - name: aaronjensen
      url-base: https://github.com/aaronjensen
  projects:
    - name: zmk
      remote: aaronjensen
      revision: adv360-beta
      import: app/west.yml
  self:
    path: config
```
